// SPDX-License-Identifier: GPL-2.0+

#include <dt-bindings/iio/mt635x-auxadc.h>
&mtk_gauge {
	DIFFERENCE_FULLOCV_ITH = <(250)>;
	TEMPERATURE_T4 = <(-10)>;
	/delete-property/TEMPERATURE_T5;
	ACTIVE_TABLE = <(5)>;
	charger = <&bq24158>;
        bootvoltage = <&chosen>;
	io-channels = <&pmic_auxadc AUXADC_BAT_TEMP>,
		<&pmic_auxadc AUXADC_BATADC>,
		<&pmic_auxadc AUXADC_VBIF>,
		<&pmic_auxadc AUXADC_IMP>,
		<&pmic_auxadc AUXADC_ISENSE>,
		<&auxadc 2>;
	io-channel-names = "pmic_battery_temp",
		"pmic_battery_voltage",
		"pmic_bif_voltage",
		"pmic_ptim_voltage",
		"pmic_isense_voltage",
		"batteryID-channel";
	#include "mediatek/bat_setting/Bangkok_tf_battery_VK_TLi028C7_table_ext.dtsi"
	#include "mediatek/bat_setting/Bangkok_tf_battery_BYD_TLi028C1_table_ext.dtsi"
#if defined(TARGET_BUILD_MMITEST) || defined(TARGET_BUILD_CERTIFICATION) || defined(TARGET_BUILD_GCF) || defined(DISABLE_TEMPERATURE_DETECTION_AND_THERMAL_POLICY)
	FIXED_BATTERY_TEMPERATURE = <25>;
#endif
};
