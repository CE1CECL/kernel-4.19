## drivers/input/fingerprint/Kconfig
```kconfig
#
#Fingerprint
#
menu "Fingerprint support"
	depends on INPUT

config MTK_FINGERPRINT_SUPPORT
	bool "Mediatek Fingerprint"
	default n
	help
	  Fingerprint mtk driver enable/disable
	  in the kernel.Say Y here if you want to
	  use mediatek fingerprint driver,fingerprint
	  driver will support fingerprint function

#Begin Modified by zhikui.li,chang the default configuration
if MTK_FINGERPRINT_SUPPORT
config MTK_FINGERPRINT_SELECT
	string "sensor type"
	default "FT9362"
#   default "GF318M"
#end Modified by zhikui.li,chang the default configuration
endif

config MTK_FINGERPRINT
	tristate "Mediatek Fingerprint"
	default n

config FOCAL_FINGERPRINT
        bool "Focaltech Fingerprint"
        default n

config JRD_SUNWAVE_FINGERPRINT
	tristate "SUNWAVE Fingerprint"
	default n


if MTK_FINGERPRINT_SELECT = "GF318M" ||  MTK_FINGERPRINT_SELECT = "GF5216"
config GOODIX_FINGERPRINT
	bool "Goodix Fingerprint"
	default y
	help
	  Goodix Fingerprint chip GF316M/GF318M/GF3118M/GF518M/GF5118M/GF516M/GF816M/GF3208/GF3206/
	  GF3266/GF3288/GF5206/GF5216/GF5208 TEE driver

config GOODIX_SENSOR_TYPE
	string "SENSOR_TYPE"
	default "GF5216"
	help
	  Must input sensor type, or default is GF316M GF318M GF3118M GF518M GF5118M GF516M GF816M
	  GF3208 GF3206 GF3266 GF3288 GF5206 GF5216 GF5208
endif
endmenu
```

## drivers/input/touchscreen/mediatek/Kconfig
```kconfig
#
# Touchscreen driver configuration
#
menuconfig INPUT_TOUCHSCREEN
	bool "Touchscreens"
	help
	  Say Y here, and a list of supported touchscreens will be displayed.
	  This option doesn't affect the kernel.

	  If unsure, say Y.

if INPUT_TOUCHSCREEN

config TOUCHSCREEN_MTK
	bool "MediaTek Touch Panel Driver"
        default n
	help
	  Say Y here if you have MediaTek touch panel.

	  If unsure, say N.

	  To compile this dirver as a module, choose M here: the
	  module will be called.

config TOUCHSCREEN_PHYSICAL_ROTATION_WITH_LCM
	bool "MediaTek Touch Panel Rotation With LCM"
	default y
	help
	  Say N here if touch panel is not physical rotated as LCM does.
	  Physically rotated means that this driver will map
	  the reported coordination to diagonal position.

	  If unsure, say Y.

#Add-begin by baiwei.peng for TP porting on 2020/09/03
source "drivers/input/touchscreen/mediatek/tokyolitetmo_nt36525bh_touch/Kconfig"

config TOUCHSCREEN_MTK_TOKYOLITETMO_FT8006S
    bool "TOKYOLITETMO_FT8006S"
    default n
    help
      Say Y here if you have Focaltech touch panel.
      If unsure, say N.
source "drivers/input/touchscreen/mediatek/tokyolitetmo_ft8006s_touch/Kconfig"
#Add-end by baiwei.peng for TP porting on 2020/09/03

config TOUCHSCREEN_MTK_GT1151_BANGKOKTF
    bool "CONFIG_TOUCHSCREEN_MTK_GT1151_BANGKOKTF"
    default n
    help
      Say Y here if you have Focaltech touch panel.
      If unsure, say N.
source "drivers/input/touchscreen/mediatek/bangkoktf_GT1151/Kconfig"

config TOUCHSCREEN_MTK_FT5446_BANGKOKTF
	bool "fermi att ft5446 for Mediatek package"
	default n
	help
	  Say Y here if you have ft5446 touch panel.

	  If unsure, say N.

	  To compile this dirver as a module, choose M here: the
	  module will be called.
source "drivers/input/touchscreen/mediatek/bangkoktf_ft5446/Kconfig"

config TOUCHSCREEN_MTK_CHSC5XXX_BANGKOKTF
	bool "bangkoktf chsc5xxx for Mediatek package"
	default n
	help
	  Say Y here if you have chsc5xxx touch panel.

	  If unsure, say N.

	  To compile this dirver as a module, choose M here: the
	  module will be called.
source "drivers/input/touchscreen/mediatek/bangkoktf_CHSC5XXX/Kconfig"


config TOUCHSCREEN_MTK_BETTERLIFE_BANGKOKTF
	bool "bangkoktf betterlife for Mediatek package"
	default n
	help
	  Say Y here if you have betterlife touch panel.

	  If unsure, say N.

	  To compile this dirver as a module, choose M here: the
	  module will be called.
source "drivers/input/touchscreen/mediatek/bangkoktf_betterlife_ts/Kconfig"

endif
```

## drivers/input/touchscreen/mediatek/bangkoktf_betterlife_ts/Kconfig
```kconfig
#
# Touchscreen driver configuration
#

config TOUCHSCREEN_MTK_BTL
    bool "betterlife tp"
	default n
	---help---
	betterlife fingerprint.

config BTL_CHECK_CHIPID
	bool "btl check chip id during boot"
	default y
	help
	Say Y here if you want to check chip id

	If unsure, say N.

	To compile this dirver as a module, choose M here: the
	module will be called.

config BTL_DEBUG
	bool "btl debug enable"
	default y
	help
	Say Y here if you want to enable debug

	If unsure, say N.

	To compile this dirver as a module, choose M here: the
	module will be called.

config TPD_ROTATE_90
	bool "btl for Mediatek package"
	default n
	help
	Say Y here if you have btl touch panel TPD_ROTATE_90.

	If unsure, say N.

	To compile this dirver as a module, choose M here: the
	module will be called.

config TPD_ROTATE_180
	bool "btl for Mediatek package"
	default n 
	help
	Say Y here if you have bl6xx0 touch panel TPD_ROTATE_180.

	If unsure, say N.

	To compile this dirver as a module, choose M here: the
	module will be called.

config TPD_ROTATE_270
	bool "btl for Mediatek package"
	default n
	help
	Say Y here if you have btl touch panel TPD_ROTATE_270.

	If unsure, say N.

	To compile this dirver as a module, choose M here: the
	module will be called.

config TPD_ROTATE_X_180
	bool "btl for Mediatek package"
	default n
	help
	Say Y here if you have bl6xx0 touch panel TPD_ROTATE_180.

	If unsure, say N.

	To compile this dirver as a module, choose M here: the
	module will be called.


config BL_AUTO_UPGRADE_SUPPORT
	bool "btl for Mediatek package"
	default n
	help
	Say Y here if you have btl touch panel BL_AUTO_UPGRADE_SUPPORT.

	If unsure, say N.

	To compile this dirver as a module, choose M here: the
	module will be called.

config CUST_BL_APK_DEBUG
	bool "btl for Mediatek package"
	default n
	help
	Say Y here if you have btl touch panel CUST_BL_APK_DEBUG.

	If unsure, say N.

	To compile this dirver as a module, choose M here: the
	module will be called.
```

## drivers/input/touchscreen/mediatek/bangkoktf_ft5446/Kconfig
```kconfig
#
# Focaltech Touchscreen driver configuration
#

config TOUCHSCREEN_MTK_SEOUL_ATT_FT5446
    bool "Focaltech Touchscreen"
    default n
    help
      Say Y here if you have Focaltech touch panel.
      If unsure, say N.
      
config TOUCHSCREEN_MTK_SEOUL_ATT_FT5446
    string "Focaltech ts directory name"
    default "focaltech_touch"
    depends on TOUCHSCREEN_FTS
    
```

## drivers/input/touchscreen/mediatek/tokyolitetmo_ft8006s_touch/Kconfig
```kconfig
#
# Focaltech Touchscreen driver configuration
#

if TOUCHSCREEN_MTK_TOKYOLITETMO_FT8006S
  
config TOUCHSCREEN_FTS_DIRECTORY
    string "Focaltech ts directory name"
    default "focaltech_touch"
    depends on TOUCHSCREEN_MTK_TOKYOLITETMO_FT8006S

endif
```

## drivers/misc/mediatek/sensors-1.0/accelerometer/Kconfig
```kconfig
config MTK_AUTO_DETECT_ACCELEROMETER
	bool "MTK AUTO DETECT ACCELEROMETER Sensor"
	depends on MTK_SENSOR_SUPPORT
	help
	  one load to support different accelerometer sensor.
	  If this option is set, multiple accelerometer driver
	  can be configured at the same time, but only one
	  can be probed.

config CUSTOM_KERNEL_ACCELEROMETER
	bool "CUSTOM KERNEL ACCELEROMETER Config"
	help
	  accelerometer sensor to detect accelerometer from x y z axis.
	  If the platform is supported for acceleometer, this
	  configuration should be configured, and the acceleometer
	  driver configuration should be configured as well.

source "drivers/misc/mediatek/sensors-1.0/accelerometer/accelhub/Kconfig"
#source "drivers/misc/mediatek/sensors-1.0/accelerometer/bmi160-i2c/Kconfig"
#source "drivers/misc/mediatek/sensors-1.0/accelerometer/lis3dh/Kconfig"
#source "drivers/misc/mediatek/sensors-1.0/accelerometer/mc3410-i2c/Kconfig"
#source "drivers/misc/mediatek/sensors-1.0/accelerometer/mc3433/Kconfig"
#source "drivers/misc/mediatek/sensors-1.0/accelerometer/mpu6050g/Kconfig"
source "drivers/misc/mediatek/sensors-1.0/accelerometer/TCT_1ST_STK8BA53/Kconfig"
source "drivers/misc/mediatek/sensors-1.0/accelerometer/TCT_2ND_MC3416/Kconfig"

#begin modified by zhikui.li,bring up sensor
source "drivers/misc/mediatek/sensors-1.0/accelerometer/seoul_2nd_MC3416/Kconfig"
source "drivers/misc/mediatek/sensors-1.0/accelerometer/Seoul_1st_STK8BA53/Kconfig"
source "drivers/misc/mediatek/sensors-1.0/accelerometer/TOKYO_1st_STK8BA53/Kconfig"
source "drivers/misc/mediatek/sensors-1.0/accelerometer/significant_motion/Kconfig"
source "drivers/misc/mediatek/sensors-1.0/accelerometer/tokyo_2nd_MC3416/Kconfig"
#end modified by zhikui.li,bring up sensor
```

## drivers/misc/mediatek/sensors-1.0/accelerometer/Seoul_1st_STK8BA53/Kconfig
```kconfig
config SEOUL_1ST_STK8BA53
	bool "SEOUL_1ST_STK8BA53 for MediaTek package"
	default n
	help
	  It support different accelerometer sensor.
	  If this option is set,
	  it will support
	  STK8BAXX Accelerometer.
```

## drivers/misc/mediatek/sensors-1.0/accelerometer/TCT_2ND_MC3416/Kconfig
```kconfig
config TCT_2ND_MC3416
	bool "TCT_2ND_MC3416 for MediaTek package"
	default n
	help
	  It support different accelerometer sensor.
          If this option is set,
	  it will support
          TCT_2ND_MC3416 Accelerometer.
```

## drivers/misc/mediatek/sensors-1.0/accelerometer/tokyo_2nd_MC3416/Kconfig
```kconfig
config TOKYO_2ND_MC3416
	bool "TOKYO_2ND_MC3416 for MediaTek package"
	default n
	help
	  It support different accelerometer sensor.
          If this option is set,
	  it will support
          TOKYO_2ND_MC3416 Accelerometer.
```

## drivers/tct/Kconfig
```kconfig
config TCT_UI_TURBO
	bool "ui turbo v1.0"
	default n

config TCT_STAT
	bool "tct statistics feature"
	depends on TCT_UI_TURBO
	default n

config TCT_PERF
	bool "tct performace control device"
	depends on TCT_UI_TURBO
	default n
```
